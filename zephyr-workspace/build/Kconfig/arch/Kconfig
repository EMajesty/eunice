## zephyr-workspace/build/Kconfig/arch/Kconfig
```kconfig
# Load Zephyr Arch Kconfig descriptions.
osource "/home/emaj/git/eunice/zephyr-workspace/zephyr/arch/hexagon/Kconfig"
osource "/home/emaj/git/eunice/zephyr-workspace/zephyr/arch/rx/Kconfig"
osource "/home/emaj/git/eunice/zephyr-workspace/zephyr/arch/x86/Kconfig"
osource "/home/emaj/git/eunice/zephyr-workspace/zephyr/arch/xtensa/Kconfig"
osource "/home/emaj/git/eunice/zephyr-workspace/zephyr/arch/sparc/Kconfig"
osource "/home/emaj/git/eunice/zephyr-workspace/zephyr/arch/riscv/Kconfig"
osource "/home/emaj/git/eunice/zephyr-workspace/zephyr/arch/posix/Kconfig"
osource "/home/emaj/git/eunice/zephyr-workspace/zephyr/arch/openrisc/Kconfig"
osource "/home/emaj/git/eunice/zephyr-workspace/zephyr/arch/mips/Kconfig"
osource "/home/emaj/git/eunice/zephyr-workspace/zephyr/arch/arm64/Kconfig"
osource "/home/emaj/git/eunice/zephyr-workspace/zephyr/arch/arm/Kconfig"
osource "/home/emaj/git/eunice/zephyr-workspace/zephyr/arch/arc/Kconfig"
```

## zephyr-workspace/build/Kconfig/boards/Kconfig.defconfig
```kconfig
# Load Zephyr board defconfig descriptions.
osource "/home/emaj/git/eunice/zephyr-workspace/zephyr/boards/others/promicro_nrf52840/Kconfig.defconfig"
```

## zephyr-workspace/build/Kconfig/boards/Kconfig.promicro_nrf52840
```kconfig
# Load board Kconfig descriptions.
osource "/home/emaj/git/eunice/zephyr-workspace/zephyr/boards/others/promicro_nrf52840/Kconfig.promicro_nrf52840"
```
